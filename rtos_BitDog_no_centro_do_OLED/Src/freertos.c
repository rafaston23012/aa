/* USER CODE BEGIN Header */
/**
  ******************************************************************************
  * @file          : freertos.c
  * @brief         : Configuração e implementação das tarefas do sistema utilizando FreeRTOS.
  * @author 	   : Wu Shin Ting
  * @date		   : 20/03/2026
  ******************************************************************************
  * @attention
  *
  * Copyright (c) 2026 STMicroelectronics.
  * All rights reserved.
  *
  * This software is licensed under terms that can be found in the LICENSE file
  * in the root directory of this software component.
  * If no LICENSE file comes with this software, it is provided AS-IS.
  *
  ******************************************************************************
 * @details
 * Este arquivo contém a inicialização do kernel do FreeRTOS e a criação das
 * tarefas da aplicação. O sistema atual possui uma única tarefa responsável
 * pelo controle e atualização de um display OLED baseado no controlador SSD1306.
 *
 * O sistema possui 1 tarefa:
 * @li OledTask
 *     - Prioridade: Normal (osPriorityNormal)
 *     - Stack: 512 bytes
 *     - Função: Controle do display OLED
 *
 * A tarefa OledTask é responsável por iniciar o driver ssd1306 e gerenciar a saída gráfica
 * no display OLED.
 *
 * @note
 * - A renderização é feita de forma manual e pode ser otimizada utilizando
 *   operações em bloco no framebuffer.
 *
 * - Não há uso de mecanismos de sincronização (mutex, semáforos ou filas),
 *   pois existe apenas uma tarefa ativa no sistema.
 *
 * - O uso de RTOS neste caso permite escalabilidade futura, como a adição de
 *   novas tarefas (sensores, comunicação, interface, etc.).
 *
 * - A função osDelay() é utilizada para liberar a CPU para outras tarefas,
 *   evitando bloqueio ativo (busy wait).
 *
 */
/* USER CODE END Header */

/* Includes ------------------------------------------------------------------*/
#include "FreeRTOS.h"
#include "task.h"
#include "main.h"
#include "cmsis_os.h"

/* Private includes ----------------------------------------------------------*/
/* USER CODE BEGIN Includes */
#include "ssd1306.h"

/* USER CODE END Includes */

/* Private typedef -----------------------------------------------------------*/
/* USER CODE BEGIN PTD */

/* USER CODE END PTD */

/* Private define ------------------------------------------------------------*/
/* USER CODE BEGIN PD */
/* Ajuste necessário para alinhamento com o início da imagem */
#define OFFSET 6
/* USER CODE END PD */

/* Private macro -------------------------------------------------------------*/
/* USER CODE BEGIN PM */

/* USER CODE END PM */

/* Private variables ---------------------------------------------------------*/
/* USER CODE BEGIN Variables */
/* @brief O bitmap é utilizado para renderização manual no framebuffer do
 * display OLED SSD1306 por meio da função ssd1306_DrawPixel().
 *
 * Dimensões:
 * - Largura: 80 pixels
 * - Altura: 60 pixels
 *
 * Tamanho total:
 * - 80 x 60 / 8 = 600 bytes
 */
const uint8_t bitdog_big[600] = {
    0x00,0x00,0x00,0x00,0x18,0x00,0x00,0x00,0x00,0x00,0x00,0x00,0x00,0x00,0x3C,0x00,
    0x00,0x00,0x00,0x00,0x00,0x00,0x00,0x00,0x3E,0x00,0x00,0x00,0x00,0x00,0x00,0x00,
    0x00,0x00,0x37,0x00,0x00,0x00,0x00,0x00,0x00,0x00,0x00,0x01,0xF3,0x80,0x00,0x00,
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    0x00,0x00,0x00,0x00
};
/* USER CODE END Variables */

/* Definitions for oledTask */
osThreadId_t oledTaskHandle;
const osThreadAttr_t oledTask_attributes = {
  .name = "oledTask",
  .stack_size = 128 * 4,
  .priority = (osPriority_t) osPriorityNormal,
};

/* Private function prototypes -----------------------------------------------*/
/* USER CODE BEGIN FunctionPrototypes */

/* USER CODE END FunctionPrototypes */

void OledTask(void *argument);

void MX_FREERTOS_Init(void); /* (MISRA C 2004 rule 8.1) */

/**
  * @brief  FreeRTOS initialization
  * @param  None
  * @retval None
  */
void MX_FREERTOS_Init(void) {
  /* USER CODE BEGIN Init */

  /* USER CODE END Init */

  /* USER CODE BEGIN RTOS_MUTEX */
  /* add mutexes, ... */
  /* USER CODE END RTOS_MUTEX */

  /* USER CODE BEGIN RTOS_SEMAPHORES */
  /* add semaphores, ... */
  /* USER CODE END RTOS_SEMAPHORES */

  /* USER CODE BEGIN RTOS_TIMERS */
  /* start timers, add new ones, ... */
  /* USER CODE END RTOS_TIMERS */

  /* USER CODE BEGIN RTOS_QUEUES */
  /* add queues, ... */
  /* USER CODE END RTOS_QUEUES */

  /* Create the thread(s) */
  /* creation of oledTask */
  oledTaskHandle = osThreadNew(OledTask, NULL, &oledTask_attributes);

  /* USER CODE BEGIN RTOS_THREADS */
  /* add threads, ... */
  /* USER CODE END RTOS_THREADS */

  /* USER CODE BEGIN RTOS_EVENTS */
  /* add events, ... */
  /* USER CODE END RTOS_EVENTS */

}

/* USER CODE BEGIN Header_OledTask */
/**
* @brief Function implementing the oledTask thread.
* @param argument: Not used
* @retval None
*
*  O comportamento desta tarefa é descrita a seguir:
*
* 1. Limpa o display (preenche com cor preta)
* 2. Atualiza o display físico
* 3. Aguarda 3 segundos (osDelay)
* 4. Renderiza manualmente um bitmap monocromático (80x60 pixels)
*    - O bitmap é armazenado em memória como um array linear de 600 bytes
*    - Cada byte representa 8 pixels horizontais (formato MONO_HLSB)
*    - A renderização é feita pixel a pixel utilizando ssd1306_DrawPixel()
*    - Um deslocamento horizontal (OFFSET) é aplicado ao índice do bitmap
* 5. Atualiza o display com a imagem desenhada
* 6. Aguarda 6 segundos
* 7. Repete o ciclo indefinidamente
*
*/
/* USER CODE END Header_OledTask */
void OledTask(void *argument)
{
	/* USER CODE BEGIN OledTask */
	/* Inicialiar o driver ssd1306 */
	ssd1306_Init();
	/* Infinite loop */
	for(;;)
	{
		ssd1306_Fill(Black);
		ssd1306_UpdateScreen();
		osDelay(3000);

		/* ===================== Desenho do Bitmap ===================== */

		/**
		 * @brief Desenha a imagem BitDog (versão grande) no framebuffer do SSD1306.
		 *
		 * A imagem possui resolução de 80×60 pixels e está armazenada em formato
		 * monocromático (1 bit por pixel), com organização horizontal e bit menos
		 * significativo primeiro (MONO_HLSB).
		 *
		 * Os dados da imagem estão contidos em um buffer linear de 600 bytes
		 * (10 bytes por linha × 60 linhas). Cada byte representa 8 pixels
		 * horizontais consecutivos.
		 *
		 * O acesso ao bitmap considera um deslocamento inicial (@ref OFFSET),
		 * permitindo compensar um offset horizontal presente na origem dos dados
		 * (por exemplo, quando a imagem foi extraída de um framebuffer maior ou
		 * com stride diferente).
		 *
		 * A posição de desenho (24, 2) foi escolhida para centralizar a imagem
		 * horizontalmente em um display de 128×64 pixels.
		 *
		 * Este código é funcionalmente equivalente à chamada em MicroPython:
		 * @code
		 * oled.blit(fbuf_bdbig, 24, 2)
		 * @endcode
		 *
		 * @note O código valida o índice do buffer para evitar acesso fora dos
		 *       limites do bitmap.
		 */
		for (uint8_t y = 0; y < 60; y++) {
			for (uint8_t x = 0; x < 10; x++) {
				/* Índice do byte no bitmap (MONO_HLSB) */
				uint32_t byte_index = OFFSET + y * 10 + x;
				if (byte_index < 600) {
					for (uint8_t bit = 0; bit < 8; bit++) {

						/* Bit correspondente ao pixel dentro do byte */
						uint8_t bit_mask = 1 << (bit & 0x07);

						/* Testa se o pixel está ativo */
						if (bitdog_big[byte_index] & bit_mask) {
							ssd1306_DrawPixel(24+(x*8+(7-bit)), 2+y, White);
						}
					}
				}
			}
		}
		ssd1306_UpdateScreen();
		osDelay(6000);
	}
	/* USER CODE END OledTask */
}

/* Private application code --------------------------------------------------*/
/* USER CODE BEGIN Application */

/* USER CODE END Application */

