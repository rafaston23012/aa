# file: rtos_neopixel_V1A.ioc
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Dma.Request0=TIM1_UP
Dma.TIM1_UP.0.Direction=DMA_MEMORY_TO_PERIPH
Dma.TIM1_UP.0.FIFOMode=DMA_FIFOMODE_ENABLE
Dma.TIM1_UP.0.FIFOThreshold=DMA_FIFO_THRESHOLD_1QUARTERFULL
Dma.TIM1_UP.0.Instance=DMA2_Stream5
Dma.TIM1_UP.0.MemBurst=DMA_MBURST_SINGLE
Dma.TIM1_UP.0.MemDataAlignment=DMA_MDATAALIGN_HALFWORD
Dma.TIM1_UP.0.MemInc=DMA_MINC_ENABLE
Dma.TIM1_UP.0.Mode=DMA_NORMAL
Dma.TIM1_UP.0.PeriphBurst=DMA_PBURST_SINGLE
Dma.TIM1_UP.0.PeriphDataAlignment=DMA_PDATAALIGN_HALFWORD
Dma.TIM1_UP.0.PeriphInc=DMA_PINC_DISABLE
Dma.TIM1_UP.0.Priority=DMA_PRIORITY_LOW
FREERTOS.Tasks01=neopixelTask,24,128,NeopixelTask,Default,NULL,Dynamic,NULL,NULL
FREERTOS.configUSE_NEWLIB_REENTRANT=1
Mcu.Family=STM32F4
Mcu.Name=STM32F411C(C-E)Ux
Mcu.Package=UFQFPN48
NVIC.DMA2_Stream5_IRQn=true\:5\:0\:false\:false\:true\:true\:false\:true\:true
NVIC.PriorityGroup=NVIC_PRIORITYGROUP_4
NVIC.TIM2_IRQn=true\:15\:0\:false\:false\:true\:false\:false\:true\:true
NVIC.TimeBase=TIM2_IRQn
NVIC.TimeBaseIP=TIM2
PA10.GPIO_Label=NEOPIXEL
PA10.Signal=S_TIM1_CH3
PA13.Mode=Serial_Wire
PA13.Signal=SYS_JTMS-SWDIO
PA14.Mode=Serial_Wire
PA14.Signal=SYS_JTCK-SWCLK
PH0\ -\ OSC_IN.Mode=HSE-External-Oscillator
PH0\ -\ OSC_IN.Signal=RCC_OSC_IN
PH1\ -\ OSC_OUT.Mode=HSE-External-Oscillator
PH1\ -\ OSC_OUT.Signal=RCC_OSC_OUT
ProjectManager.HeapSize=0x200
ProjectManager.StackSize=0x400
ProjectManager.TargetToolchain=STM32CubeIDE
RCC.48MHZClocksFreq_Value=32000000
RCC.AHBCLKDivider=RCC_SYSCLK_DIV4
RCC.AHBFreq_Value=16000000
RCC.APB1Freq_Value=16000000
RCC.APB1TimFreq_Value=16000000
RCC.APB2Freq_Value=16000000
RCC.APB2TimFreq_Value=16000000
RCC.CortexFreq_Value=16000000
RCC.HCLKFreq_Value=16000000
RCC.HSE_VALUE=25000000
RCC.HSI_VALUE=16000000
RCC.LSE_VALUE=32768
RCC.PLLM=25
RCC.PLLN=128
RCC.PLLSourceVirtual=RCC_PLLSOURCE_HSE
RCC.SYSCLKFreq_VALUE=64000000
RCC.SYSCLKSource=RCC_SYSCLKSOURCE_PLLCLK
RCC.VCOOutputFreq_Value=128000000
SH.S_TIM1_CH3.0=TIM1_CH3,PWM Generation3 CH3
TIM1.AutoReloadPreload=TIM_AUTORELOAD_PRELOAD_ENABLE
TIM1.Channel-PWM\ Generation3\ CH3=TIM_CHANNEL_3
TIM1.Period=9
TIM1.Prescaler=1
TIM1.TIM_MasterOutputTrigger=TIM_TRGO_UPDATE
VP_FREERTOS_VS_CMSIS_V2.Mode=CMSIS_V2
VP_SYS_VS_tim2.Mode=TIM2
VP_TIM1_VS_ClockSourceINT.Mode=Internal
board=custom

// file: Src/main.c
/* USER CODE BEGIN Header */
/**
  ******************************************************************************
  * @file           : main.c
  * @brief          : Main program body
  ******************************************************************************
  * @attention
  *
  * Copyright (c) 2026 STMicroelectronics.
  * All rights reserved.
  *
  * This software is licensed under terms that can be found in the LICENSE file
  * in the root directory of this software component.
  * If no LICENSE file comes with this software, it is provided AS-IS.
  *
  ******************************************************************************
  */
/* USER CODE END Header */
#include "main.h"
#include "cmsis_os.h"
#include "dma.h"
#include "tim.h"
#include "gpio.h"

void SystemClock_Config(void);
void MX_FREERTOS_Init(void);

int main(void)
{

  /* MCU Configuration--------------------------------------------------------*/

  /* Reset of all peripherals, Initializes the Flash interface and the Systick. */
  HAL_Init();

  /* Configure the system clock */
  SystemClock_Config();

  /* Initialize all configured peripherals */
  MX_GPIO_Init();
  MX_DMA_Init();
  MX_TIM1_Init();

  /* Init scheduler */
  osKernelInitialize();  /* Call init function for freertos objects (in cmsis_os2.c) */
  MX_FREERTOS_Init();

  /* Start scheduler */
  osKernelStart();

  /* We should never get here as control is now taken by the scheduler */

  /* Infinite loop */
  while (1)
  {

  }
}

void SystemClock_Config(void)
{
  RCC_OscInitTypeDef RCC_OscInitStruct = {0};
  RCC_ClkInitTypeDef RCC_ClkInitStruct = {0};

  /** Configure the main internal regulator output voltage
  */
  __HAL_RCC_PWR_CLK_ENABLE();
  __HAL_PWR_VOLTAGESCALING_CONFIG(PWR_REGULATOR_VOLTAGE_SCALE1);

  /** Initializes the RCC Oscillators according to the specified parameters
  * in the RCC_OscInitTypeDef structure.
  */
  RCC_OscInitStruct.OscillatorType = RCC_OSCILLATORTYPE_HSE;
  RCC_OscInitStruct.HSEState = RCC_HSE_ON;
  RCC_OscInitStruct.PLL.PLLState = RCC_PLL_ON;
  RCC_OscInitStruct.PLL.PLLSource = RCC_PLLSOURCE_HSE;
  RCC_OscInitStruct.PLL.PLLM = 25;
  RCC_OscInitStruct.PLL.PLLN = 128;
  RCC_OscInitStruct.PLL.PLLP = RCC_PLLP_DIV2;
  RCC_OscInitStruct.PLL.PLLQ = 4;
  if (HAL_RCC_OscConfig(&RCC_OscInitStruct) != HAL_OK)
  {
    Error_Handler();
  }

  /** Initializes the CPU, AHB and APB buses clocks
  */
  RCC_ClkInitStruct.ClockType = RCC_CLOCKTYPE_HCLK|RCC_CLOCKTYPE_SYSCLK
                              |RCC_CLOCKTYPE_PCLK1|RCC_CLOCKTYPE_PCLK2;
  RCC_ClkInitStruct.SYSCLKSource = RCC_SYSCLKSOURCE_PLLCLK;
  RCC_ClkInitStruct.AHBCLKDivider = RCC_SYSCLK_DIV4;
  RCC_ClkInitStruct.APB1CLKDivider = RCC_HCLK_DIV1;
  RCC_ClkInitStruct.APB2CLKDivider = RCC_HCLK_DIV1;

  if (HAL_RCC_ClockConfig(&RCC_ClkInitStruct, FLASH_LATENCY_0) != HAL_OK)
  {
    Error_Handler();
  }
}

void HAL_TIM_PeriodElapsedCallback(TIM_HandleTypeDef *htim)
{
  if (htim->Instance == TIM2)
  {
    HAL_IncTick();
  }
}

void Error_Handler(void)
{
  __disable_irq();
  while (1)
  {
  }
}

// file: Src/freertos.c
/* USER CODE BEGIN Header */
/**
  ******************************************************************************
  * @file    freertos.c
  * @brief   FreeRTOS application and NeoPixel control task
  * @author Wu Shin Ting
  * @date   21/03/2026
  ******************************************************************************
  * @attention
  *
  * Copyright (c) 2026 STMicroelectronics.
  * All rights reserved.
  *
  * This software is licensed under terms that can be found in the LICENSE file
  * in the root directory of this software component.
  * If no LICENSE file comes with this software, it is provided AS-IS.
  *
  ******************************************************************************
  * @section overview Visão Geral
  *
  * Este arquivo contém a inicialização do FreeRTOS e a implementação da tarefa
  * responsável pelo controle de uma cadeia de LEDs NeoPixel (WS2812).
  *
  * O sistema foi projetado para operar com uma única tarefa RTOS dedicada ao
  * controle dos LEDs, garantindo simplicidade e previsibilidade temporal.
  *
  * A aplicação demonstra:
  * - Inicialização de periféricos para controle de WS2812 via PWM + DMA
  * - Manipulação de cores e padrões em LEDs
  * - Uso básico de tarefas no FreeRTOS
  *
  * Dois padrões principais são exibidos:
  * - Sequência inicial com múltiplas configurações de LEDs
  * - Alternância contínua entre dois estados nos LEDs 0 e 1
  *
  * @section user_code Código Implementado Manualmente
  *
  * O código dentro das regiões USER CODE inclui:
  * - Inicialização do driver WS2812:
  *   - ws2812_color_init()
  *   - ws2812_pwm_init()
  *
  * - Configuração de brilho global
  *
  * - Construção de padrões visuais:
  *   - Preenchimento total (fill)
  *   - Gradiente linear entre LEDs
  *   - Definição de pixels individuais e intervalos
  *
  * - Atualização dos LEDs via:
  *   - ws2812_pwm_show()
  *
  * - Lógica de alternância (toggle) entre dois estados:
  *   - LED 0 e LED 1 trocam suas cores periodicamente
  *
  * - Uso de osDelay() para controle temporal não bloqueante
  *
  * @section mental_model Modelo Mental do Sistema
  *
  * O sistema segue o modelo de:
  *
  *   "Single Owner Resource"
  *
  * onde
  * - A tarefa NeopixelTask é a única responsável pelo acesso ao hardware WS2812
  * - Não há concorrência sobre o periférico
  *
  * Fluxo simplificado:
  *
  *   [Init] -> [Configuração inicial LEDs] -> [Loop infinito]
  *                                              |
  *                                              v
  *                                     [Alterna estado A/B]
  *                                              |
  *                                              v
  *                                      [Atualiza LEDs]
  *                                              |
  *                                              v
  *                                          [Delay]
  *
  * Estados:
  * - Estado A:
  *     LED0 = (255,100,0)
  *     LED1 = (255,0,0)
  *
  * - Estado B:
  *     LED0 = (255,0,0)
  *     LED1 = (255,100,0)
  *
  * A alternância é determinística e sequencial, não dependendo de sincronização
  * entre múltiplas tarefas.
  *
  * @section cube_config Configuração no CubeMX
  *
  * Este projeto foi configurado utilizando o STM32CubeMX com as seguintes decisões:
  *
  * - FreeRTOS:
  *   - Uma única tarefa (neopixelTask)
  *   - Prioridade: Normal
  *   - Stack: 512 bytes
  *
  * - Timers:
  *   - TIM1 configurado para geração de PWM
  *   - Canal utilizado: TIM1 Channel 3
  *   - Evento de update habilitado para DMA
  *
  * - DMA:
  *   - Canal associado ao TIM1 Update
  *   - Utilizado para alimentar o CCR do timer (geração do sinal WS2812)
  *
  * - GPIO:
  *   - Pino configurado como saída do canal PWM
  *
  * - Estratégia adotada:
  *   - Uso de PWM + DMA para atender aos requisitos de temporização do WS2812
  *   - Evitar bit-banging por CPU
  *
  * - Arquitetura RTOS:
  *   - Apenas uma tarefa controla o periférico
  *   - Não há uso de mutex, semáforos ou filas neste exemplo
  *   - Justificativa: os estados são previsíveis e sequenciais
  *
  * @note
  * Este projeto prioriza simplicidade e clareza didática.
  * Em aplicações mais complexas, recomenda-se:
  * - Uso de filas para comunicação entre tarefas
  * - Separação entre lógica de aplicação e driver de hardware
  *
  ******************************************************************************
  */
/* USER CODE END Header */

#include "FreeRTOS.h"
#include "task.h"
#include "main.h"
#include "cmsis_os.h"

/* USER CODE BEGIN Includes */
#include "ws2812_pwm.h"
#include "ws2812_color.h"
#include "tim.h"
/* USER CODE END Includes */

/* Definitions for neopixelTask */
osThreadId_t neopixelTaskHandle;
const osThreadAttr_t neopixelTask_attributes = {
  .name = "neopixelTask",
  .stack_size = 128 * 4,
  .priority = (osPriority_t) osPriorityNormal,
};

void NeopixelTask(void *argument);

void MX_FREERTOS_Init(void); /* (MISRA C 2004 rule 8.1) */

void MX_FREERTOS_Init(void) {

  /* Create the thread(s) */
  /* creation of neopixelTask */
  neopixelTaskHandle = osThreadNew(NeopixelTask, NULL, &neopixelTask_attributes);

}

/* USER CODE BEGIN Header_NeopixelTask */
/**
  * @brief  RTOS task responsible for driving NeoPixel updates.
  *
  * @param  argument: Not used.
  * @retval None
  *
  * @details
  * Esta tarefa executa duas fases distintas:
  *
  * 1. Sequência inicial de configuração visual:
  *    - Inicializa os módulos de controle de cor e PWM
  *    - Define brilho global
  *    - Preenche todos os LEDs com uma cor base
  *    - Aplica padrões adicionais:
  *        - Gradiente linear em um intervalo de LEDs
  *        - Segmento fixo com cor sólida
  *        - Pixel individual com cor específica
  *    - Cada etapa é seguida de atualização física dos LEDs e um pequeno atraso
  *
  * 2. Loop contínuo de alternância:
  *    - Alterna ciclicamente o estado de dois LEDs específicos (0 e 1)
  *    - A alternância é controlada por uma variável local (toggle)
  *    - A cada iteração:
  *        - Atualiza os valores no buffer
  *        - Envia os dados para os LEDs
  *        - Aguarda um intervalo fixo
  *
  * @note
  * - Todas as atualizações visuais só são efetivadas após chamada de ws2812_pwm_show().
  * - O uso de osDelay() permite escalonamento cooperativo com outras tarefas.
  * - A variável 'toggle' implementa um flip-flop simples para alternância de estados.
  *
  * @warning
  * Esta tarefa assume acesso exclusivo ao periférico WS2812.
  * Não é seguro acessar o driver de LEDs a partir de múltiplas tarefas sem sincronização.
  *
  * @see ws2812_pwm_show
  * @see ws2812_set_pixel
  * @see ws2812_set_pixel_line_gradient
  */
/* USER CODE END Header_NeopixelTask */
void NeopixelTask(void *argument)
{
  /* USER CODE BEGIN NeopixelTask */
	/* Inicializar com a quantidade máxima, 25 LEDs */
	ws2812_color_init(25);
	ws2812_pwm_init();

	ws2812_set_brightness(50);   /* intensidade da cor */

	ws2812_fill_slots ();     /* preencher os slots que marcam fim da cadeia de LEDs */

	ws2812_fill(255, 50, 0);  /* preencher o buffer dos LEDs com "orange" */

	ws2812_pwm_show();			  /* mostrar nos LEDs */

	osDelay(100);           /* tempo de espera */

	/* setar no buffer o gradiente linear aritmético entre verde (LED 3) a azul (LED 13) */
	ws2812_set_pixel_line_gradient(3, 13, 0, 255, 0, 0, 0, 255);

	ws2812_pwm_show();   /* mostra nos LEDs */

	osDelay (100);            /* tempo de espera */

	ws2812_set_pixel_line(14, 16, 255, 0, 0); /* setar no buffer a cor vermelha do LED 14 a 16 */

	ws2812_pwm_show();

	osDelay (100);            /* tempo de espera */

	ws2812_set_pixel(20, 255, 255, 255);

	ws2812_pwm_show();

	osDelay (100);            /* tempo de espera */

	uint8_t toggle = 0;
	/* Infinite loop */
	for(;;)
	{
		if (toggle)
		{
			ws2812_set_pixel(0, 255, 100, 0); /* yellow */
			ws2812_set_pixel(1, 255, 0, 0);   /* red */
		}
		else
		{
			ws2812_set_pixel(0, 255, 0, 0);
			ws2812_set_pixel(1, 255, 100, 0);
		}
		toggle ^= 1;

		ws2812_pwm_show();

		osDelay (100);            /* tempo de espera */

	}
  /* USER CODE END NeopixelTask */
}
